## configs/sparky1_defconfig
```kconfig
CONFIG_M68K=y
CONFIG_DM=y
CONFIG_TEXT_BASE=0x00000000
CONFIG_SYS_MALLOC_LEN=0x40000
CONFIG_ENV_SIZE=0x2000
CONFIG_ENV_IS_NOWHERE=y
CONFIG_DEFAULT_DEVICE_TREE="sparky1"
CONFIG_SYS_MONITOR_LEN=0x80000
CONFIG_SYS_LOAD_ADDR=0x40200000
CONFIG_TARGET_SPARKY1=y
CONFIG_SYS_MONITOR_BASE=0x00000400
CONFIG_BOOTDELAY=5
CONFIG_DISPLAY_BOARDINFO=y
CONFIG_SYS_MALLOC_BOOTPARAMS=y
# CONFIG_CMDLINE_EDITING is not set
# CONFIG_AUTO_COMPLETE is not set
CONFIG_SYS_PBSIZE=276
# CONFIG_CMD_IMLS is not set
# CONFIG_CMD_LOADB is not set
# CONFIG_CMD_LOADS is not set
# CONFIG_CMD_SETEXPR is not set
CONFIG_HUSH_PARSER=y
CONFIG_CMD_CACHE=y
CONFIG_CMD_TIME=y
CONFIG_CMD_GPIO=y
CONFIG_CMD_GPIO_READ=y
CONFIG_CMD_DM=y
CONFIG_SYS_RELOC_GD_ENV_ADDR=y
# CONFIG_NET is not set
CONFIG_USE_HOSTNAME=y
CONFIG_HOSTNAME="sparky1"
# CONFIG_MCFTMR is not set
CONFIG_MC68681_UART=y
CONFIG_DEBUG_UART=y
CONFIG_DEBUG_UART_XR68C681=y
CONFIG_DEBUG_UART_BASE=0x80000000
CONFIG_DEBUG_UART_CLOCK=3686400
# CONFIG_WATCHDOG_TIMEOUT_MSECS=10000
CONFIG_LOG_MAX_LEVEL=7
CONFIG_TRACE_EARLY=y
# TIMER
CONFIG_TIMER=y
CONFIG_MC68681_TIMER=y
# GPIO
CONFIG_DM_GPIO=y
CONFIG_MC68681_GPIO=y
```
